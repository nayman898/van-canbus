#pragma once
#include <cstddef>
#include <cstdint>
#include <cstdio>
#include <cstring>

struct CanRecord {
  uint64_t timestampUs;
  uint32_t sequence;
  uint32_t id;
  uint8_t dlc;
  bool extended;
  bool rtr;
  uint8_t data[8];
};

// Return zero on invalid input or truncation; never emit partial CSV rows.
inline size_t formatRecord(char *out, size_t capacity, const CanRecord &r) {
  if (r.dlc > 8 || r.id > (r.extended ? 0x1FFFFFFFu : 0x7FFu)) return 0;
  char payload[17] = {};
  if (!r.rtr) {
    for (unsigned i = 0; i < r.dlc; ++i)
      std::snprintf(payload + 2 * i, 3, "%02X", r.data[i]);
  }
  const int n = std::snprintf(out, capacity, "%llu,%lu,%08lX,%u,%u,%u,%s\n",
      static_cast<unsigned long long>(r.timestampUs),
      static_cast<unsigned long>(r.sequence), static_cast<unsigned long>(r.id),
      unsigned(r.extended), unsigned(r.rtr), unsigned(r.dlc), payload);
  return n > 0 && static_cast<size_t>(n) < capacity ? static_cast<size_t>(n) : 0;
}

inline bool validLogName(const char *name) {
  // Fixed names generated by this firmware: B1234ABCD-S0001.csv
  if (!name || std::strlen(name) != 19 || name[0] != 'B' ||
      std::strncmp(name + 9, "-S", 2) || std::strcmp(name + 15, ".csv")) return false;
  for (int i = 1; i <= 8; ++i)
    if (!((name[i] >= '0' && name[i] <= '9') || (name[i] >= 'A' && name[i] <= 'F'))) return false;
  for (int i = 11; i <= 14; ++i) if (name[i] < '0' || name[i] > '9') return false;
  return true;
}
